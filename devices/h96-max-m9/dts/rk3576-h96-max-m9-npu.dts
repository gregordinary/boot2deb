// SPDX-License-Identifier: (GPL-2.0+ OR MIT)
/*
 * H96 MAX M9 with its RKNN NPU enabled, driven by the mainline `rocket`
 * DRM-accel driver. This is the board description plus the NPU, and needs the
 * RK3576 NPU nodes from the rk3576-npu patch series, which come in disabled.
 *
 * Compute core 0 runs. rknn_core_1 and rknn_mmu_1 stay at the dtsi default.
 * The part has one convolution buffer -- 1 MB in RKNN_TOP, outside either
 * core's register bank, with a single clock pair both core nodes list, where
 * the RK3588 gives each core its own -- and two rocket jobs in flight at once
 * corrupt each other's output: 96-100% of calls wrong, over as much as 94% of
 * the surface, deltas spanning the whole int8 range, across process
 * boundaries. Overlap in time is the entire condition -- the same two cores
 * driven through a mutex, one job in flight, are bit-exact -- so binding one
 * core leaves the kernel nowhere to schedule a concurrent job and puts the
 * failure out of reach by construction rather than making it unlikely. What
 * would make the second core usable is a userspace encoder that stages each
 * core into a disjoint slice of the buffer, the way the vendor driver's
 * cache_sgt_init partitions it; no RK3576 encoder exists yet.
 *
 * Giving it up costs nothing measurable. Two fds on core 0 alone run 1.5-1.7x
 * a single fd, which is submit pipelining filling dispatch gaps at a ~340 us
 * submit floor rather than parallelism; adding core 1 lands inside that range
 * at small shapes and below it at 128x1024x1024.
 *
 * The rail belongs to the power domain. Mainline rocket references no
 * regulator API, so npu-supply is inert, and a rail nothing claims is disabled
 * as unused at t~33 s, long after a clean probe at t~8 s -- a runtime failure,
 * not a boot failure. RK3576_PD_NPU carries need_regulator, so domain-supply
 * on pd_npu makes the domain the rail's consumer: vdd_npu_s0 comes up before
 * the domain powers and goes down after it drops, the way vdd_gpu_s0 follows
 * pd_gpu. The rail keeps regulator-boot-on and does not take
 * regulator-always-on, which would hold it up whatever the domain does.
 * npu-supply stays because the binding requires it.
 *
 * The power domains are not a board's business: rknn_core_0 carries both
 * RK3576_PD_NPU0 and RK3576_PD_NPU1 in the SoC dtsi, because the convolution
 * buffer is read through PD_NPU1 whichever core computes -- so core 0 alone
 * holds the pair up and the buffer stays fully fed with core 1 down. rocket
 * attaches whatever the node lists, so trimming one would run half fed rather
 * than fail; the binding pins it at two. See rk3576/npu/README.md in the
 * patches repo.
 */

#include "rk3576-h96-max-m9.dts"

&pd_npu {
	domain-supply = <&vdd_npu_s0>;
};

&rknn_core_0 {
	npu-supply = <&vdd_npu_s0>;
	status = "okay";
};

&rknn_mmu_0 {
	status = "okay";
};
