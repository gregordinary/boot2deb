// SPDX-License-Identifier: (GPL-2.0+ OR MIT)
/*
 * H96 MAX M9 (RK3576) -- NPU-enabled variant of the board DTB.
 *
 * The full board is the sibling rk3576-h96-max-m9.dts, reused verbatim by
 * #include so the two DTBs never drift. This wrapper adds only the RK3576 NPU
 * (rocket) enable: it lights up the rknn_core_0 / rknn_mmu_0 nodes that the
 * rk3576-npu kernel patch profile adds (disabled) to rk3576.dtsi, wires the NPU
 * power rail, and keeps that rail on.
 *
 * The board enable is board-specific, which is why it lives here and not in the
 * SoC dtsi: vdd_npu_s0 is this board's RK806 dcdc-reg2. It is boot-on but not
 * always-on and is off in suspend, so the regulator core's disable-unused pass
 * would tear it down under a deferred NPU probe; regulator-always-on holds it up,
 * matching the rocket bring-up's expectation. Both NPU power domains are attached
 * (NPU0 + NPU1): rocket computes on core 0, but the CBUF->CMAC read path is only
 * fully powered with NPU1 up as well.
 *
 * Experimental. This makes the NPU probe and expose the accel uAPI (/dev/accel)
 * for register probing and job submission; it is not a working accelerator.
 */

#include "rk3576-h96-max-m9.dts"

&rknn_core_0 {
	npu-supply = <&vdd_npu_s0>;
	power-domains = <&power RK3576_PD_NPU0>, <&power RK3576_PD_NPU1>;
	status = "okay";
};

&rknn_mmu_0 {
	status = "okay";
};

&vdd_npu_s0 {
	regulator-always-on;
};
